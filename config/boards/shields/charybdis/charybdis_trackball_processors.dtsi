/*
 * Copyright (c) 2024 The ZMK Contributors
 * SPDX-License-Identifier: MIT
 */

#include "charybdis_layers.h"
#include <dt-bindings/zmk/input_transform.h>
#include <input/processors.dtsi>

#define CHARYBDIS_TRACKBALL_PROCESSORS \
    scroll { \
        layers = <POINTER>; \
        input-processors = <&zip_xy_transform (INPUT_TRANSFORM_Y_INVERT)>, <&zip_xy_scaler 1 50>, <&zip_xy_to_scroll_mapper>; \
    }; \
    snipe { \
        layers = <NAV>; \
        input-processors = <&zip_xy_scaler 1 4>; \
    };
